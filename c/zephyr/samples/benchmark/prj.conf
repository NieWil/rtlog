## CMakeLists.txt
```
cmake_minimum_required(VERSION 3.20.0)
find_package(Zephyr REQUIRED HINTS $ENV{ZEPHYR_BASE})
project(rtlog_benchmark)
option(RTLOG_BENCH_FOOTPRINT "Build the matched ten-site footprint workload" OFF)
option(RTLOG_BENCH_STRESS "Build the matched overload and interrupt workload" OFF)
if(RTLOG_BENCH_STRESS)
	target_sources(app PRIVATE src/stress.c)
elseif(RTLOG_BENCH_FOOTPRINT)
	target_sources(app PRIVATE src/footprint.c)
elseif(CONFIG_LOG)
	target_sources(app PRIVATE src/zephyr_log.c)
else()
	target_sources(app PRIVATE src/main.c)
endif()
```

## sample.yaml
```
sample:
  name: rtlog Cortex-M cycle benchmark
tests:
  sample.rtlog.benchmark:
    platform_allow:
      - nucleo_l432kc
    tags:
      - rtlog
      - benchmark
    harness: console
    harness_config:
      type: one_line
      regex:
        - "RTLOG_BENCH_DONE"
```

## prj.conf
```kconfig
CONFIG_RTLOG=y
CONFIG_RTLOG_MAX_THREADS=1
CONFIG_RTLOG_RING_SIZE=2048
CONFIG_RTLOG_DRAIN_THREAD=n
CONFIG_LOG=n
CONFIG_PRINTK=y
CONFIG_CONSOLE=y
CONFIG_UART_CONSOLE=y
CONFIG_BOOT_BANNER=n
CONFIG_MAIN_STACK_SIZE=2048
CONFIG_SPEED_OPTIMIZATIONS=y
CONFIG_STD_C11=y
CONFIG_GNU_C_EXTENSIONS=y
```

## baseline.conf
```kconfig
CONFIG_RTLOG=n
CONFIG_LOG=n
CONFIG_THREAD_LOCAL_STORAGE=y
```

## common.conf
```kconfig
CONFIG_PRINTK=y
CONFIG_CONSOLE=y
CONFIG_UART_CONSOLE=y
CONFIG_BOOT_BANNER=n
CONFIG_MAIN_STACK_SIZE=2048
CONFIG_SPEED_OPTIMIZATIONS=y
CONFIG_STD_C11=y
CONFIG_GNU_C_EXTENSIONS=y
CONFIG_THREAD_LOCAL_STORAGE=y
```

## zephyr.conf
```kconfig
CONFIG_RTLOG=n
CONFIG_LOG=y
CONFIG_LOG_MODE_DEFERRED=y
CONFIG_LOG_PROCESS_THREAD=n
CONFIG_LOG_BACKEND_UART=n
CONFIG_LOG_BUFFER_SIZE=2048
CONFIG_LOG_MODE_OVERFLOW=n
CONFIG_LOG_BLOCK_IN_THREAD=n
CONFIG_LOG_RUNTIME_FILTERING=y
CONFIG_LOG_DEFAULT_LEVEL=4
CONFIG_LOG_TIMESTAMP_64BIT=y
CONFIG_LOG_PRINTK=n
```

## src/main.c
```c
#include <stdlib.h>
#include <cmsis_core.h>
#include <zephyr/irq.h>
#include <zephyr/kernel.h>
#include <zephyr/sys/printk.h>
#include <zephyr/sys/util.h>
#include "rtlog.h"

#define SAMPLE_COUNT 256u
#define DRAIN_INTERVAL 16u

static uint32_t samples[SAMPLE_COUNT];
static volatile uint32_t input = 42u;

static int discard(void *user, const uint8_t *bytes, size_t len) {
    ARG_UNUSED(user);
    ARG_UNUSED(bytes);
    ARG_UNUSED(len);
    return 0;
}

static void baseline(void) { __asm__ volatile("" ::: "memory"); }
static void disabled(void) { RTLOG_DEBUG("disabled={}", input); }
static void empty(void) { RTLOG_INFO("tick"); }
static void one_u32(void) { RTLOG_INFO("value={}", input); }
static void three_u32(void) { RTLOG_INFO("values={} {} {}", input, input, input); }
static void string_arg(void) { RTLOG_INFO("state={}", "running"); }
static void span_pair(void) {
    rtlog_span_t span = RTLOG_SPAN_BEGIN("work");
    RTLOG_SPAN_END(span);
}

static int compare_cycles(const void *left, const void *right) {
    uint32_t first = *(const uint32_t *)left;
    uint32_t second = *(const uint32_t *)right;
    return (first > second) - (first < second);
}

static uint32_t measure(void (*operation)(void)) {
    unsigned int key = irq_lock();
    __asm__ volatile("" ::: "memory");
    uint32_t start = DWT->CYCCNT;
    operation();
    __asm__ volatile("" ::: "memory");
    uint32_t elapsed = DWT->CYCCNT - start;
    irq_unlock(key);
    return elapsed;
}

static int run_case(const char *name, void (*operation)(void), int full) {
    rtlog_drain(discard, NULL);
    if (full) {
        for (unsigned int index = 0; index < CONFIG_RTLOG_RING_SIZE; index++) {
            one_u32();
        }
    } else {
        for (unsigned int index = 0; index < DRAIN_INTERVAL; index++) {
            operation();
        }
        rtlog_drain(discard, NULL);
    }
    uint32_t drops_before = rtlog_dropped();
    for (unsigned int index = 0; index < SAMPLE_COUNT; index++) {
        samples[index] = measure(operation);
        if (!full && (index + 1u) % DRAIN_INTERVAL == 0u) {
            rtlog_drain(discard, NULL);
        }
    }
    size_t remaining_frames = rtlog_drain(discard, NULL);
    uint32_t drops = rtlog_dropped() - drops_before;
    if (full) {
        drops -= CONFIG_RTLOG_RING_SIZE - (uint32_t)remaining_frames;
    }
    qsort(samples, SAMPLE_COUNT, sizeof(samples[0]), compare_cycles);
    printk("%s,%u,%u,%u,%u,%u\n", name, samples[0],
           samples[SAMPLE_COUNT / 2u], samples[(SAMPLE_COUNT * 95u + 99u) / 100u - 1u],
           samples[SAMPLE_COUNT - 1u], drops);
    if ((!full && drops != 0u) || (full && drops != SAMPLE_COUNT)) {
        printk("RTLOG_BENCH_ERROR: unexpected drops in %s\n", name);
        return -1;
    }
    return 0;
}

int main(void) {
    k_msleep(2000);
    CoreDebug->DEMCR |= CoreDebug_DEMCR_TRCENA_Msk;
    if ((DWT->CTRL & DWT_CTRL_NOCYCCNT_Msk) != 0u) {
        printk("RTLOG_BENCH_ERROR: DWT CYCCNT unavailable\n");
        return 0;
    }
    DWT->CYCCNT = 0u;
    DWT->CTRL |= DWT_CTRL_CYCCNTENA_Msk;
    __DSB();
    __ISB();
    uint32_t first = DWT->CYCCNT;
    for (volatile unsigned int spin = 0; spin < 32u; spin++) {
    }
    if (DWT->CYCCNT == first) {
        printk("RTLOG_BENCH_ERROR: DWT CYCCNT is not running\n");
        return 0;
    }

    rtlog_set_thread_name("benchmark");
    rtlog_set_level(RTLOG_LEVEL_INFO);
    rtlog_set_spans(1);
    rtlog_drain(discard, NULL);
    printk("RTLOG_BENCH core_hz=%u timestamp_hz=%u samples=%u ring=%u threads=%u\n",
           (unsigned int)SystemCoreClock, (unsigned int)sys_clock_hw_cycles_per_sec(),
           SAMPLE_COUNT, CONFIG_RTLOG_RING_SIZE, CONFIG_RTLOG_MAX_THREADS);
    printk("case,min_cycles,median_cycles,p95_cycles,max_cycles,drops\n");
    if (run_case("baseline", baseline, 0) != 0 ||
        run_case("runtime_disabled", disabled, 0) != 0 ||
        run_case("no_args", empty, 0) != 0 ||
        run_case("one_u32", one_u32, 0) != 0 ||
        run_case("three_u32", three_u32, 0) != 0 ||
        run_case("string_7_bytes", string_arg, 0) != 0 ||
        run_case("span_pair", span_pair, 0) != 0 ||
        run_case("full_ring_one_u32", one_u32, 1) != 0) {
        return 0;
    }
    printk("RTLOG_BENCH_DONE\n");
    return 0;
}
```

## src/footprint.c
```c
#include <zephyr/kernel.h>
#include <zephyr/sys/printk.h>

#if defined(CONFIG_RTLOG)
#include "rtlog.h"
#define BENCH_LOG(number) RTLOG_INFO("site " #number " value={}", input)
static int discard(void *user, const uint8_t *bytes, size_t len) {
    ARG_UNUSED(user);
    ARG_UNUSED(bytes);
    ARG_UNUSED(len);
    return 0;
}
#elif defined(CONFIG_LOG)
#include <zephyr/logging/log.h>
#include <zephyr/logging/log_backend.h>
#include <zephyr/logging/log_ctrl.h>
LOG_MODULE_REGISTER(footprint, LOG_LEVEL_DBG);
#define BENCH_LOG(number) LOG_INF("site " #number " value=%u", input)
static void discard(const struct log_backend *backend, union log_msg_generic *message) {
    ARG_UNUSED(backend);
    ARG_UNUSED(message);
}
static void panic(const struct log_backend *backend) { ARG_UNUSED(backend); }
static const struct log_backend_api backend_api = { .process = discard, .panic = panic };
LOG_BACKEND_DEFINE(footprint_sink, backend_api, false);
#else
#define BENCH_LOG(number) ((void)input)
#endif

static volatile uint32_t input = 42u;

int main(void) {
#if defined(CONFIG_RTLOG)
    rtlog_set_thread_name("footprint");
#elif defined(CONFIG_LOG)
    log_backend_enable(&footprint_sink, NULL, LOG_LEVEL_INF);
#endif
    for (;;) {
        BENCH_LOG(0);
        BENCH_LOG(1);
        BENCH_LOG(2);
        BENCH_LOG(3);
        BENCH_LOG(4);
        BENCH_LOG(5);
        BENCH_LOG(6);
        BENCH_LOG(7);
        BENCH_LOG(8);
        BENCH_LOG(9);
#if defined(CONFIG_RTLOG)
        rtlog_drain(discard, NULL);
#elif defined(CONFIG_LOG)
        while (log_process()) {
        }
#endif
        printk("footprint alive\n");
        k_msleep(1000);
    }
    return 0;
}
```

## src/stress.c
```c
#include <stdlib.h>
#include <string.h>
#include <cmsis_core.h>
#include <zephyr/kernel.h>
#include <zephyr/sys/atomic.h>
#include <zephyr/sys/printk.h>

#define OBSERVATIONS 512u
#define BATCHES 16u

static uint32_t samples[OBSERVATIONS];
static char payload[128];
static volatile uint32_t input = 42u;
static uint32_t delivered;
static atomic_t interrupt_count;

#if defined(CONFIG_RTLOG)
#include "rtlog.h"
#define LOGGER_NAME "rtlog"
static int discard(void *user, const uint8_t *bytes, size_t len) {
    ARG_UNUSED(user);
    ARG_UNUSED(bytes);
    ARG_UNUSED(len);
    return 0;
}
static void emit_integer(void) { RTLOG_INFO("value={}", input); }
static void emit_payload(void) { RTLOG_INFO("payload={}", payload); }
static void drain(void) { delivered += rtlog_drain(discard, NULL); }
static uint32_t drops(void) { return rtlog_dropped(); }
static void initialize(void) {
    rtlog_set_thread_name("stress");
    rtlog_set_level(RTLOG_LEVEL_INFO);
}
#else
#include <zephyr/logging/log.h>
#include <zephyr/logging/log_backend.h>
#include <zephyr/logging/log_ctrl.h>
LOG_MODULE_REGISTER(stress, LOG_LEVEL_DBG);
#define LOGGER_NAME "zephyr"
static uint32_t discarded;
static void discard(const struct log_backend *backend, union log_msg_generic *message) {
    ARG_UNUSED(backend);
    ARG_UNUSED(message);
    delivered++;
}
static void count_dropped(const struct log_backend *backend, uint32_t count) {
    ARG_UNUSED(backend);
    discarded += count;
}
static void panic(const struct log_backend *backend) { ARG_UNUSED(backend); }
static const struct log_backend_api backend_api = {
    .process = discard, .dropped = count_dropped, .panic = panic,
};
LOG_BACKEND_DEFINE(stress_sink, backend_api, false);
static void emit_integer(void) { LOG_INF("value=%u", input); }
static void emit_payload(void) { LOG_INF("payload=%s", payload); }
static void drain(void) { while (log_process()) {} }
static uint32_t drops(void) { return discarded; }
static void initialize(void) { log_backend_enable(&stress_sink, NULL, LOG_LEVEL_INF); }
#endif

static void timer_expired(struct k_timer *timer) {
    ARG_UNUSED(timer);
    atomic_inc(&interrupt_count);
    k_busy_wait(20);
}
K_TIMER_DEFINE(load_timer, timer_expired, NULL);

static int compare_cycles(const void *left, const void *right) {
    uint32_t first = *(const uint32_t *)left;
    uint32_t second = *(const uint32_t *)right;
    return (first > second) - (first < second);
}

static int run_case(const char *name, void (*emit)(void), unsigned int interval,
                    int interrupt_load, int stall) {
    drain();
    uint32_t delivered_before = delivered;
    uint32_t drops_before = drops();
    uint32_t interrupts_before = (uint32_t)atomic_get(&interrupt_count);
    if (interrupt_load) {
        k_timer_start(&load_timer, K_USEC(100), K_USEC(100));
    }
    uint32_t maximum = 0u;
    uint32_t median_max = 0u;
    uint32_t p95_max = 0u;
    uint32_t drain_cycles = 0u;
    for (unsigned int batch = 0; batch < BATCHES; batch++) {
        for (unsigned int index = 0; index < OBSERVATIONS; index++) {
            __asm__ volatile("" ::: "memory");
            uint32_t start = DWT->CYCCNT;
            emit();
            __asm__ volatile("" ::: "memory");
            samples[index] = DWT->CYCCNT - start;
            if (stall) {
                k_busy_wait(13);
            }
            if (interval && (index + 1u) % interval == 0u) {
                start = DWT->CYCCNT;
                drain();
                drain_cycles += DWT->CYCCNT - start;
            }
        }
        qsort(samples, OBSERVATIONS, sizeof(samples[0]), compare_cycles);
        if (samples[OBSERVATIONS - 1u] > maximum) maximum = samples[OBSERVATIONS - 1u];
        if (samples[OBSERVATIONS / 2u] > median_max) median_max = samples[OBSERVATIONS / 2u];
        uint32_t p95 = samples[(OBSERVATIONS * 95u + 99u) / 100u - 1u];
        if (p95 > p95_max) p95_max = p95;
    }
    k_timer_stop(&load_timer);
    uint32_t interrupts = (uint32_t)atomic_get(&interrupt_count) - interrupts_before;
    uint32_t start = DWT->CYCCNT;
    drain();
    drain_cycles += DWT->CYCCNT - start;
    uint32_t accepted = delivered - delivered_before;
    uint32_t lost = drops() - drops_before;
    printk("%s,%u,%u,%u,%u,%u,%u,%u,%u\n", name, OBSERVATIONS * BATCHES,
           accepted, lost, median_max, p95_max, maximum, drain_cycles, interrupts);
    if (accepted + lost != OBSERVATIONS * BATCHES ||
        (interval && lost != 0u) || (!interval && lost == 0u) ||
        (interrupt_load && interrupts == 0u)) {
        printk("STRESS_ERROR accounting_or_load\n");
        return -1;
    }
    delivered_before = delivered;
    drops_before = drops();
    emit_integer();
    drain();
    if (delivered != delivered_before + 1u || drops() != drops_before) {
        printk("STRESS_ERROR recovery\n");
        return -1;
    }
    return 0;
}

int main(void) {
    k_msleep(2000);
    CoreDebug->DEMCR |= CoreDebug_DEMCR_TRCENA_Msk;
    DWT->CYCCNT = 0u;
    DWT->CTRL |= DWT_CTRL_CYCCNTENA_Msk;
    __DSB();
    __ISB();
    uint32_t first = DWT->CYCCNT;
    k_busy_wait(10);
    if (DWT->CYCCNT == first) {
        printk("STRESS_ERROR cycle_counter\n");
        return 0;
    }
    memset(payload, 'x', sizeof(payload) - 1u);
    initialize();
    emit_integer();
    drain();
    printk("STRESS logger=%s core_hz=%u ticks_hz=%u attempts_per_case=%u\n",
           LOGGER_NAME, (unsigned int)SystemCoreClock, CONFIG_SYS_CLOCK_TICKS_PER_SEC,
           OBSERVATIONS * BATCHES);
    printk("case,attempts,accepted,drops,max_batch_median,max_batch_p95,max_cycles,drain_cycles,interrupts\n");
    if (run_case("drained_integer", emit_integer, 16u, 0, 0) ||
        run_case("dynamic_string_127", emit_payload, 4u, 0, 0) ||
        run_case("no_drain_burst", emit_integer, 0u, 0, 0) ||
        run_case("consumer_paused_100ms", emit_integer, 0u, 0, 1) ||
        run_case("irq_load_integer", emit_integer, 16u, 1, 0) ||
        run_case("irq_load_string_127", emit_payload, 4u, 1, 0)) {
        return 0;
    }
    printk("STRESS_DONE\n");
    return 0;
}
```

## src/zephyr_log.c
```c
#include <stdlib.h>
#include <cmsis_core.h>
#include <zephyr/irq.h>
#include <zephyr/kernel.h>
#include <zephyr/logging/log.h>
#include <zephyr/logging/log_backend.h>
#include <zephyr/logging/log_ctrl.h>
#include <zephyr/sys/printk.h>

LOG_MODULE_REGISTER(benchmark, LOG_LEVEL_DBG);

#define SAMPLE_COUNT 256u
#define DRAIN_INTERVAL 16u

static uint32_t samples[SAMPLE_COUNT];
static volatile uint32_t input = 42u;
static uint32_t processed;
static uint32_t dropped;

static void discard(const struct log_backend *backend, union log_msg_generic *message) {
    ARG_UNUSED(backend);
    ARG_UNUSED(message);
    processed++;
}

static void count_dropped(const struct log_backend *backend, uint32_t count) {
    ARG_UNUSED(backend);
    dropped += count;
}

static void panic(const struct log_backend *backend) { ARG_UNUSED(backend); }
static const struct log_backend_api backend_api = {
    .process = discard,
    .dropped = count_dropped,
    .panic = panic,
};
LOG_BACKEND_DEFINE(benchmark_sink, backend_api, false);

static void baseline(void) { __asm__ volatile("" ::: "memory"); }
static void disabled(void) { LOG_DBG("disabled=%u", input); }
static void empty(void) { LOG_INF("tick"); }
static void one_u32(void) { LOG_INF("value=%u", input); }
static void three_u32(void) { LOG_INF("values=%u %u %u", input, input, input); }
static void string_arg(void) { LOG_INF("state=%s", "running"); }

static void drain(void) {
    while (log_process()) {
    }
}

static int compare_cycles(const void *left, const void *right) {
    uint32_t first = *(const uint32_t *)left;
    uint32_t second = *(const uint32_t *)right;
    return (first > second) - (first < second);
}

static int run_case(const char *name, void (*operation)(void), int enabled) {
    operation();
    drain();
    uint32_t processed_before = processed;
    uint32_t dropped_before = dropped;
    for (unsigned int index = 0; index < SAMPLE_COUNT; index++) {
        unsigned int key = irq_lock();
        __asm__ volatile("" ::: "memory");
        uint32_t start = DWT->CYCCNT;
        operation();
        __asm__ volatile("" ::: "memory");
        samples[index] = DWT->CYCCNT - start;
        irq_unlock(key);
        if ((index + 1u) % DRAIN_INTERVAL == 0u) {
            drain();
        }
    }
    drain();
    qsort(samples, SAMPLE_COUNT, sizeof(samples[0]), compare_cycles);
    printk("%s,%u,%u,%u,%u,%u\n", name, samples[0], samples[SAMPLE_COUNT / 2u],
           samples[(SAMPLE_COUNT * 95u + 99u) / 100u - 1u], samples[SAMPLE_COUNT - 1u],
           dropped - dropped_before);
    if (processed - processed_before != (enabled ? SAMPLE_COUNT : 0u) ||
        dropped != dropped_before) {
        printk("RTLOG_BENCH_ERROR: unexpected accepted/dropped count in %s\n", name);
        return -1;
    }
    return 0;
}

int main(void) {
    k_msleep(2000);
    CoreDebug->DEMCR |= CoreDebug_DEMCR_TRCENA_Msk;
    if ((DWT->CTRL & DWT_CTRL_NOCYCCNT_Msk) != 0u) {
        printk("RTLOG_BENCH_ERROR: DWT CYCCNT unavailable\n");
        return 0;
    }
    DWT->CYCCNT = 0u;
    DWT->CTRL |= DWT_CTRL_CYCCNTENA_Msk;
    __DSB();
    __ISB();
    uint32_t first = DWT->CYCCNT;
    for (volatile unsigned int spin = 0; spin < 32u; spin++) {
    }
    if (DWT->CYCCNT == first) {
        printk("RTLOG_BENCH_ERROR: DWT CYCCNT is not running\n");
        return 0;
    }
    log_backend_enable(&benchmark_sink, NULL, LOG_LEVEL_INF);
    log_filter_set(&benchmark_sink, 0, log_source_id_get("benchmark"), LOG_LEVEL_INF);
    drain();
    printk("ZEPHYR_BENCH core_hz=%u samples=%u buffer=%u\n",
           (unsigned int)SystemCoreClock, SAMPLE_COUNT, CONFIG_LOG_BUFFER_SIZE);
    printk("case,min_cycles,median_cycles,p95_cycles,max_cycles,drops\n");
    if (run_case("baseline", baseline, 0) != 0 ||
        run_case("runtime_disabled", disabled, 0) != 0 ||
        run_case("no_args", empty, 1) != 0 ||
        run_case("one_u32", one_u32, 1) != 0 ||
        run_case("three_u32", three_u32, 1) != 0 ||
        run_case("string_7_bytes", string_arg, 1) != 0) {
        return 0;
    }
    printk("RTLOG_BENCH_DONE\n");
    return 0;
}
```
