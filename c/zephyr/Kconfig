## c/zephyr/Kconfig
```kconfig
config RTLOG
	bool "rtlog deferred binary logging and tracing"
	depends on ARCH_HAS_THREAD_LOCAL_STORAGE
	select THREAD_LOCAL_STORAGE
	help
	  Lock-free, allocation-free binary logging (RTLOG_INFO, spans) with
	  format strings decoded on the host by the rtlog CLI.

if RTLOG

config RTLOG_MAX_THREADS
	int "Threads that can log at the same time"
	default 8

config RTLOG_RING_SIZE
	int "Ring size per thread in bytes (power of two)"
	default 2048

config RTLOG_STRIP
	bool "Keep format strings out of the firmware image"
	depends on LINKER_DEVNULL_SUPPORT
	select LINKER_DEVNULL_MEMORY
	help
	  Place the call-site descriptors and their format strings in a
	  region that is not part of zephyr.bin or zephyr.hex. They stay in
	  zephyr.elf, where `rtlog contract --elf` reads them. Saves the
	  descriptors (28 bytes per call site on a 32-bit target) and the
	  strings, and the shipped image no longer contains the log texts.
	  Function names are not recorded.

config RTLOG_DRAIN_THREAD
	bool "Run a low-priority drain thread"
	default y

config RTLOG_DRAIN_PERIOD_MS
	int "Drain period in milliseconds"
	default 10
	depends on RTLOG_DRAIN_THREAD

config RTLOG_DRAIN_PRIORITY
	int "Drain thread priority"
	default 14
	depends on RTLOG_DRAIN_THREAD

config RTLOG_DRAIN_STACK_SIZE
	int "Drain thread stack size"
	default 1024
	depends on RTLOG_DRAIN_THREAD

endif
```
